## base_external/package/aesd-assignments/Config.in
```kconfig
config BR2_PACKAGE_AESD_ASSIGNMENTS
	bool "aesd-assignments"
	depends on BR2_PACKAGE_BUSYBOX
	help
	  Builds and installs the Assignment 3 writer, finder, and tester
	  utilities into the target root filesystem.
```
